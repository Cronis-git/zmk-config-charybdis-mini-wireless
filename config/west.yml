## config/west.yml
```yaml
manifest:
  remotes:
    - name: zmkfirmware
      url-base: https://github.com/petejohanson
    - name: teamspatzenhirn
      url-base: https://github.com/teamspatzenhirn

  projects:
    - name: zmk
      remote: zmkfirmware
      revision: feat/pointers-move-scroll
      import: app/west.yml

    - name: pmw3389_zephyr_driver
      remote: teamspatzenhirn   # ✅ исправлено
      revision: master

  self:
    path: config
```
